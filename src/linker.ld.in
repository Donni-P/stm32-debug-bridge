ENTRY(Reset_Handler)

_estack = ABSOLUTE(0x20000000 + @RAM_SIZE@-1);    /* end of RAM */
_Min_Heap_Size = 0x200;      /* required amount of heap  */
_Min_Stack_Size = 0x400; /* required amount of stack */

MEMORY
{
    FLASH (rx)  : ORIGIN = 0x08000000 + @FLASH_OFFSET@,  LENGTH = @FLASH_SIZE@ - @FLASH_OFFSET@ - @FLASH_PAGE_SIZE@
    RAM (rwx)   : ORIGIN = 0x20000000,  LENGTH = @RAM_SIZE@
    FLASH_EE (rw)  : ORIGIN = 0x08000000 + @FLASH_SIZE@ - @FLASH_PAGE_SIZE@,  LENGTH = @FLASH_PAGE_SIZE@
}

SECTIONS
{
    .text : {
        . = ALIGN(512);
        KEEP(*(.isr_vector)) /* Startup code */
        . = ALIGN(4);
        *(.text)           /* .text sections (code) */
        *(.text*)          /* .text* sections (code) */
        *(.glue_7)         /* glue arm to thumb code */
        *(.glue_7t)        /* glue thumb to arm code */
        *(.eh_frame)

        KEEP (*(.init))
        KEEP (*(.fini))

        . = ALIGN(4);
        _etext = .;        /* define a global symbols at end of code */

    } >FLASH

    .rodata : {
        . = ALIGN(4);
        *(.rodata)         /* .rodata sections (constants, strings, etc.) */
        *(.rodata*)        /* .rodata* sections (constants, strings, etc.) */
        . = ALIGN(4);

        PROVIDE_HIDDEN (__preinit_array_start = .);
        KEEP (*(.preinit_array*))
        PROVIDE_HIDDEN (__preinit_array_end = .);

        PROVIDE_HIDDEN (__init_array_start = .);
        KEEP (*(SORT(.init_array.*)))
        KEEP (*(.init_array*))
        PROVIDE_HIDDEN (__init_array_end = .);

        PROVIDE_HIDDEN (__fini_array_start = .);
        KEEP (*(SORT(.fini_array.*)))
        KEEP (*(.fini_array*))
        PROVIDE_HIDDEN (__fini_array_end = .);

    } >FLASH

    .ARM.extab   : { *(.ARM.extab* .gnu.linkonce.armextab.*) } >FLASH
    .ARM : {
        __exidx_start = .;
        *(.ARM.exidx*)
        __exidx_end = .;
    } >FLASH

    . = ALIGN(4);
    _sidata = LOADADDR(.data);

    .data : 
    {
        . = ALIGN(4);
        _sdata = .;        /* create a global symbol at data start */
        *(.data)           /* .data sections */
        *(.data*)          /* .data* sections */

        *(.dynamic)
        *(.got)
        *(.got.plt)

        . = ALIGN(4);
        _edata = .;        /* define a global symbol at data end */
    } >RAM AT> FLASH

    .bss (NOLOAD) :
    {
        /* This is used by the startup in order to initialize the .bss secion */
        _sbss = .;         /* define a global symbol at bss start */
        __bss_start__ = _sbss;
        *(.bss)
        *(.bss*)
        *(COMMON)

        . = ALIGN(4);
        _ebss = .;         /* define a global symbol at bss end */
        __bss_end__ = _ebss;
    } >RAM

    ._user_heap_stack (NOLOAD):
    {
        . = ALIGN(8);
        PROVIDE ( end = . );
        PROVIDE ( _end = . );
        . = . + _Min_Heap_Size;
        . = . + _Min_Stack_Size;
        . = ALIGN(8);
    } >RAM


    .flashconfig (NOLOAD) : {
        * ( .flashconfig )
    } >FLASH_EE
    .ARM.attributes 0 : { *(.ARM.attributes) }
  .gpioa 0x40010800 (NOLOAD) : { *(.gpioa) }
  .gpiob 0x40010c00 (NOLOAD) : { *(.gpiob) }
  .gpioc 0x40011000 (NOLOAD) : { *(.gpioc) }
  .gpiod 0x40011400 (NOLOAD) : { *(.gpiod) }
  .gpioe 0x40011800 (NOLOAD) : { *(.gpioe) }
  .gpiof 0x40011c00 (NOLOAD) : { *(.gpiof) }
  .gpiog 0x40012000 (NOLOAD) : { *(.gpiog) }
  .afio 0x40010000 (NOLOAD) : { *(.afio) }
  .flash 0x40022000 (NOLOAD) : { *(.flash) }
  .rcc  0x40021000 (NOLOAD) : { *(.rcc) }
}
